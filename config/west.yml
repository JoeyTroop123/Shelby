## config/west.yml
```yaml
manifest:
  remotes:
    - name: zmkfirmware
      url-base: https://github.com/zmkfirmware
    - name: r2d2rogers
      url-base: https://github.com/zmkfirmware
  projects:
    - name: zmk
      remote: r2d2rogers
      revision: main
      import: app/west.yml
  self:
    path: config
```
